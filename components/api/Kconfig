## components/api/Kconfig
```kconfig
menu "API Config"
    config API_KEY
    string "API Key"
    default "abc123"

endmenu
```

## components/wifi/Kconfig
```kconfig
menu "OTA Config"
    config SSID
    string "SSID"
    default "my-ssid"

    config PASSWORD
    string "Password"
    default "password"

endmenu
```

## main/Kconfig.projbuild
```kconfig
menu "Project config"
    config OTA_URL
    string "OTA Firmware URL"
    default "https://github.com/cwsnow1/arrivals/releases/latest/download/arrivals.bin"
endmenu
```

## sdkconfig.defaults
```kconfig
CONFIG_IDF_TARGET="esp32s3"
CONFIG_ESP_DEFAULT_CPU_FREQ_MHZ_240=y
CONFIG_ESPTOOLPY_FLASHSIZE_4MB=y
CONFIG_ESPTOOLPY_HEADER_FLASHSIZE_UPDATE=y
CONFIG_PARTITION_TABLE_TWO_OTA_LARGE=y
CONFIG_COMPILER_OPTIMIZATION_PERF=y

CONFIG_LV_USE_CLIB_MALLOC=y
CONFIG_LV_USE_CLIB_STRING=y
CONFIG_LV_USE_CLIB_SPRINTF=y
CONFIG_LV_DEF_REFR_PERIOD=15
CONFIG_LV_FONT_MONTSERRAT_8=y
CONFIG_LV_FONT_DEFAULT_MONTSERRAT_8=y
CONFIG_LV_BUILD_EXAMPLES=n
CONFIG_LV_BUILD_DEMOS=n
```
